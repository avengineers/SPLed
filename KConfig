## KConfig
```kconfig
mainmenu "SPLed"

source ".venv/lib/python3.11/site-packages/spl_core/config/KConfig"

menu "Features"
    config BLINKING
        bool "Blinking Feature"
        default n

    choice BRIGHTNESS_ADJUSTMENT
        depends on !BLINKING
        prompt "Select brightness adjustment mode"
            config BRIGHTNESS_ADJUSTMENT_MANUAL
                bool "Manually adjustable"

            config BRIGHTNESS_ADJUSTMENT_AUTOMATIC
                bool "Automatically adjustable"
    endchoice

    config BRIGHTNESS_ADJUSTMENT_ENABLED
        # Internal config. Not visible for the user in the menuconfig.
        bool
        default y if BRIGHTNESS_ADJUSTMENT_MANUAL || BRIGHTNESS_ADJUSTMENT_AUTOMATIC

    config BRIGHTNESS_ADJUSTMENT_PERIOD
        int "Brightness Adjustment Period (in seconds)"
        depends on BRIGHTNESS_ADJUSTMENT_AUTOMATIC
        default 5
        range 1 60
        help
            This option allows you to set the period for brightness adjustment.
            The value is in seconds and can be set between 1 and 60 seconds.

    config AUTO_OFF
        bool "Auto Off Feature"
        default n

    config AUTO_OFF_PERIOD_SECONDS
        int "Auto Off Period (in seconds)"
        depends on AUTO_OFF
        default 3600
        range 5 7200
        help
            This option allows you to set the period for the auto off feature.
            The value is in seconds and can be set between 5 and 7200 seconds.

    source "components/os/KConfig"
    source "components/light_controller/KConfig"

endmenu
```

## components/os/KConfig
```kconfig
menu "OS"
    config OS_TASK_PERIOD
        int "Task period (in milliseconds)"
        default 10
        help
            The period of the task in milliseconds.
            This value is used to calculate the task frequency.
endmenu
```

## src/light_controller/KConfig
```kconfig
menu "Light Controller"
    choice COLOR
        prompt "Select color"
        default COLOR_GREEN
        config COLOR_GREEN
            bool "Green"

        config COLOR_BLUE
            bool "Blue"

        config COLOR_RED
            bool "Red"

        config COLOR_PURPLE
            bool "Purple"
    endchoice

    choice COLOR_1
        prompt "Select second color"
        default COLOR_1_OFF
        config COLOR_1_GREEN
            bool "Green"

        config COLOR_1_BLUE
            bool "Blue"

        config COLOR_1_RED
            bool "Red"

        config COLOR_1_PURPLE
            bool "Purple"
        config COLOR_1_OFF
            bool "Off"
    endchoice

    config COLOR_1_IS_ENABLED
        # Internal config. Not visible for the user in the menuconfig.
        bool
        default y if !COLOR_1_OFF
endmenu
```

## src/os/KConfig
```kconfig
menu "OS"
    config OS_TASK_PERIOD
        int "Task period"
        default 10
        help
            The period of the task in milliseconds.
            This value is used to calculate the task frequency.
endmenu
```
