## modules/spl-extension-example/KConfig
```kconfig
menu "extension-example"
    config SPL_EXTENSION_EXAMPLE_ACTIVE
        bool
        prompt "SPL_EXTENSION_EXAMPLE_ACTIVE"
        default n

    config SPL_EXTENSION_EXAMPLE_INPUT_VARIABLE
        string
        prompt "SPL_EXTENSION_EXAMPLE_INPUT_VARIABLE"
           
endmenu
```

## modules/spl_extension_zip/KConfig
```kconfig
menu "ZIP extension"
    config ZIP_FEATURE
        bool "this is the zip feature"
        default y
    config ZIP_TOOL_VERSION
        string "zip tool version"
        default "1.0.2"
endmenu
```

## src/creator/templates/project/{{cookiecutter.name}}/KConfig
```kconfig
mainmenu "SPL Nano"
menu "Component configuration"
    config USE_COMPONENT_1
        bool "this is component one"
        default n
endmenu
```

## west.yml
```yaml
manifest:
  remotes:
    - name: avengineers
      url-base: https://github.com/avengineers

  projects:
    - name: spl
      path: modules/spl
      remote: avengineers
      revision: 0d8972082187957c01488c5985ca20561e869a8f
    - name: spl-extension-example
      path: modules/spl-extension-example
      remote: avengineers
      revision: d74e6b64fd8967238be84570863d7522b80337d4
```
